## board/hisilicon/hi3556v200/Kconfig
```kconfig
if TARGET_HI3556V200

config SYS_BOARD
	default "hi3556v200"

config SYS_VENDOR
	default "hisilicon"

config SYS_SOC
	default "hi3556v200"

config SYS_CONFIG_NAME
	default "hi3556v200"

endif
```

## board/hisilicon/hi3559v200/Kconfig
```kconfig
if TARGET_HI3559V200

config SYS_BOARD
	default "hi3559v200"

config SYS_VENDOR
	default "hisilicon"

config SYS_SOC
	default "hi3559v200"

config SYS_CONFIG_NAME
	default "hi3559v200"

endif
```

## drivers/mtd/Kconfig
```kconfig
menu "MTD Support"

config MTD
	bool "Enable Driver Model for MTD drivers"
	depends on DM
	help
	  Enable driver model for Memory Technology Devices (MTD), such as
	  flash, RAM and similar chips, often used for solid state file
	  systems on embedded devices.

config CFI_FLASH
	bool "Enable Driver Model for CFI Flash driver"
	depends on MTD
	help
	  The Common Flash Interface specification was developed by Intel,
	  AMD and other flash manufactures. It provides a universal method
	  for probing the capabilities of flash devices. If you wish to
	  support any device that is CFI-compliant, you need to enable this
	  option. Visit <http://www.amd.com/products/nvd/overview/cfi.html>
	  for more information on CFI.

config ALTERA_QSPI
	bool "Altera Generic Quad SPI Controller"
	depends on MTD
	help
	  This enables access to Altera EPCQ/EPCS flash chips using the
	  Altera Generic Quad SPI Controller. The controller converts SPI
	  NOR flash to parallel flash interface. Please find details on the
	  "Embedded Peripherals IP User Guide" of Altera.

config FLASH_PIC32
	bool "Microchip PIC32 Flash driver"
	depends on MACH_PIC32 && MTD
	help
	  This enables access to Microchip PIC32 internal non-CFI flash
	  chips through PIC32 Non-Volatile-Memory Controller.

config HIFMC
	bool "Enable HIFMC - Hisilicon Flash Memory Controller"
	depends on TARGET_HI3516EV200 || TARGET_HI3516EV300 || TARGET_HI3518EV300 || TARGET_HI3516DV200 || TARGET_HI3559AV100 || TARGET_HI3556AV100 || TARGET_HI3519AV100 || TARGET_HI3516CV500 || TARGET_HI3516DV300 || TARGET_HI3516AV300 || TARGET_HI3556V200 || TARGET_HI3559V200
	help
	  Hisilicon Flash Memory Controller support SPI Nor SPI Nand and parallel
	  Nand Flash. often used on embedded chip. This option will provide the
	  generic support for FMC drivers to register.

endmenu

source "drivers/mtd/nand/Kconfig"

source "drivers/mtd/spi/Kconfig"

source "drivers/mtd/ubi/Kconfig"
```

## drivers/ufs/Kconfig
```kconfig
menu "UFS Support"

config UFS
	bool "Support Universal Flash Storage"
	help
	  Enable the UFS driver. This driver can be used to
	  access the ufs card.

endmenu # menu "UFS Support"
```
